## components/crowpanel_board/Kconfig
```kconfig
menu "Kitchen baseline hardware"
choice KITCHEN_BOARD
    prompt "PCB revision (never inferred from silicon)"
    default KITCHEN_BOARD_UNSELECTED
config KITCHEN_BOARD_UNSELECTED
    bool "Not selected (configuration error)"
config KITCHEN_BOARD_V10
    bool "HW V1.0"
config KITCHEN_BOARD_V11
    bool "HW V1.1"
config KITCHEN_BOARD_V12
    bool "HW V1.2"
config KITCHEN_BOARD_V13
    bool "HW V1.3 (candidate)"
endchoice
choice KITCHEN_LCD
    prompt "LCD profile"
    default KITCHEN_LCD_UNSELECTED
config KITCHEN_LCD_UNSELECTED
    bool "Not selected (configuration error)"
config KITCHEN_LCD_LEGACY
    bool "Legacy 1024x600 (HW V1.0/V1.1/V1.2)"
config KITCHEN_LCD_V13
    bool "Candidate HW V1.3 9/10.1 inch 1024x600"
endchoice
choice KITCHEN_SILICON
    prompt "Silicon branch"
    default KITCHEN_SILICON_UNSELECTED
config KITCHEN_SILICON_UNSELECTED
    bool "Not selected (configuration error)"
config KITCHEN_SILICON_LEGACY
    bool "P4 0.x/1.x"
config KITCHEN_SILICON_V3
    bool "P4 3.x"
endchoice
choice KITCHEN_TOUCH_ADDRESS
    prompt "GT911 reset-selected I2C address"
    default KITCHEN_TOUCH_ADDRESS_5D
config KITCHEN_TOUCH_ADDRESS_5D
    bool "0x5D (INT low during reset)"
config KITCHEN_TOUCH_ADDRESS_14
    bool "0x14 (INT high during reset)"
endchoice
endmenu
```

## main/Kconfig.projbuild
```kconfig
menu "Kitchen development"
    config KITCHEN_RESET_TOKEN
        string "One-time Kitchen settings reset token (empty disables)"
        default ""
        help
            Development only. Set a new token, at most 63 bytes, to erase only
            namespace kitchen once at startup. The token is remembered outside
            that namespace. Keep empty for normal firmware; never erase all NVS.
endmenu
```

## sdkconfig.defaults
```kconfig
# Common baseline only; always append explicit board/LCD/silicon defaults.
CONFIG_IDF_TARGET="esp32p4"
CONFIG_PARTITION_TABLE_CUSTOM=y
CONFIG_PARTITION_TABLE_CUSTOM_FILENAME="partitions.csv"
CONFIG_PARTITION_TABLE_OFFSET=0x8000
CONFIG_ESPTOOLPY_FLASHSIZE_4MB=y
CONFIG_ESPTOOLPY_FLASHMODE_DIO=y
CONFIG_ESPTOOLPY_FLASHFREQ_80M=y
CONFIG_FREERTOS_HZ=1000
CONFIG_LV_COLOR_DEPTH_16=y
# CONFIG_LV_COLOR_16_SWAP is not set
CONFIG_LV_MEM_CUSTOM=y
CONFIG_LV_MEM_CUSTOM_INCLUDE="stdlib.h"
CONFIG_LV_DISP_DEF_REFR_PERIOD=16
# CONFIG_LV_USE_GPU_STM32_DMA2D is not set
# CONFIG_LV_USE_GPU_NXP_PXP is not set
# CONFIG_LV_USE_GPU_NXP_VG_LITE is not set
# CONFIG_LV_USE_PNG is not set
# CONFIG_LV_USE_BMP is not set
# CONFIG_LV_USE_SJPG is not set
# CONFIG_LV_USE_GIF is not set
# CONFIG_LV_USE_FREETYPE is not set
# CONFIG_LV_BUILD_EXAMPLES is not set
# CONFIG_LV_USE_DEMO_WIDGETS is not set
# CONFIG_LV_USE_DEMO_BENCHMARK is not set
CONFIG_KITCHEN_TOUCH_ADDRESS_5D=y
```
